## config/boards/yangxing/keyball_neo39/Kconfig.keyball_neo39_left
```kconfig
# Copyright (c) 2020 The ZMK Contributors
# SPDX-License-Identifier: MIT

config BOARD_KEYBALL_NEO39_LEFT
    select SOC_NRF52840_QIAA
    select ZMK_BOARD_COMPAT
    imply RETAINED_MEM
    imply RETENTION
    imply RETENTION_BOOT_MODE
```

## config/boards/yangxing/keyball_neo39/board.yml
```yaml
boards:
  - name: keyball_neo39_left
    vendor: yangxing
    socs:
      - name: nrf52840
  - name: keyball_neo39_right
    vendor: yangxing
    socs:
      - name: nrf52840
```

## config/boards/yangxing/keyball_neo39/keyball_neo39_left_defconfig
```kconfig
# SPDX-License-Identifier: MIT
#
# Peripheral (left) half: key matrix + nice!view display.
# The trackball lives on the right half, which is the central, so this half
# has no input device of its own.

# ---------------------------------------------------------------------------
# Board / SoC
# ---------------------------------------------------------------------------
CONFIG_ARM_MPU=y
CONFIG_MPU_ALLOW_FLASH_WRITE=y
CONFIG_PINCTRL=y
CONFIG_GPIO=y
CONFIG_SPI=y

# ---------------------------------------------------------------------------
# Transports
# ---------------------------------------------------------------------------
CONFIG_ZMK_USB=y
CONFIG_ZMK_BLE=y
CONFIG_ZMK_EXT_POWER=y

# ---------------------------------------------------------------------------
# Settings storage
# ---------------------------------------------------------------------------
CONFIG_USE_DT_CODE_PARTITION=y
CONFIG_BUILD_OUTPUT_UF2=y
CONFIG_NVS=y
CONFIG_SETTINGS_NVS=y
CONFIG_FLASH=y
CONFIG_FLASH_PAGE_LAYOUT=y
CONFIG_FLASH_MAP=y

# ---------------------------------------------------------------------------
# Display
# ---------------------------------------------------------------------------
CONFIG_ZMK_DISPLAY=y

# ---------------------------------------------------------------------------
# Battery reporting / deep sleep
# ---------------------------------------------------------------------------
CONFIG_ZMK_BATTERY_REPORTING=y
CONFIG_ZMK_BATTERY_REPORTING_FETCH_MODE_STATE_OF_CHARGE=y
CONFIG_ZMK_SLEEP=y
# 30 minutes
CONFIG_ZMK_IDLE_SLEEP_TIMEOUT=1800000

# ---------------------------------------------------------------------------
# Split relay plumbing, so settings edited in DYA Studio reach both halves.
# ---------------------------------------------------------------------------
CONFIG_ZMK_SPLIT_RELAY_EVENT=y
CONFIG_ZMK_SPLIT_RELAY_EVENT_DATA_LEN=240
CONFIG_ZMK_CUSTOM_SETTINGS=y
CONFIG_ZMK_CUSTOM_SETTINGS_SPLIT_RPC_RELAY=y
CONFIG_ZMK_SETTINGS_RPC=y
CONFIG_ZMK_SETTINGS_SAVE_DEBOUNCE=10000
CONFIG_ZMK_LOW_PRIORITY_THREAD_STACK_SIZE=2048

# Zephyr 4.1 enables the console by default; a keyboard does not need it.
CONFIG_CONSOLE=n
```

## config/boards/yangxing/skinner39/Kconfig.defconfig
```kconfig
# Electronut Labs Papyr board configuration

# Copyright (c) 2020 The ZMK Contributors
# SPDX-License-Identifier: MIT

if BOARD_SKINNER39_RIGHT

config ZMK_KEYBOARD_NAME
		default "Keyball Neo"

config ZMK_SPLIT_ROLE_CENTRAL
		default y
endif

if BOARD_SKINNER39_LEFT || BOARD_SKINNER39_RIGHT

config ZMK_SPLIT
		default y

config BT_CTLR
		default BT

if USB

config USB_NRFX
    default y

config USB_DEVICE_STACK
    default y

endif # USB

if ZMK_DISPLAY

# config I2C
#     default y
#
# config SSD1306
#     default y

# config LPM009M360A
# 	default n
endif # ZMK_DISPLAY


if LVGL
config ZMK_DISPLAY_DEDICATED_THREAD_STACK_SIZE
	default 8192

#config LV_HOR_RES_MAX
	#default 128
#config LV_VER_RES_MAX
	#default 32
config LV_Z_VDB_SIZE
	default 64

config LV_DPI_DEF
	default 148
config LV_Z_BITS_PER_PIXEL
	default 1
choice LV_COLOR_DEPTH
	default LV_COLOR_DEPTH_1
endchoice

endif # LVGL


config I2C
	default y
config SPI
	default y

endif 
```

## config/boards/yangxing/skinner39/board.yml
```yaml
boards:
  - name: skinner39_left
    vendor: yangxing
    socs:
      - name: nrf52840
  - name: skinner39_right
    vendor: yangxing
    socs:
      - name: nrf52840
```
